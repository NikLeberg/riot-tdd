## pkg/uKal/Kconfig
```kconfig
# Copyright (c) 2021 Sargis S Yonan
#
# This file is subject to the terms and conditions of the GNU Lesser
# General Public License v2.1. See the file LICENSE in the top level
# directory for more details.

config PACKAGE_UKAL
    bool "μKal"
    depends on TEST_KCONFIG
```
